## esp32-s3-dongle/sdkconfig.defaults
```kconfig
# Minimal defaults; user can set target/USB options via `idf.py menuconfig`.

# Enable TinyUSB device stack.
CONFIG_TINYUSB_CDC_ENABLED=y
CONFIG_TINYUSB_HID_COUNT=1

# NimBLE (preferred BLE host).
CONFIG_BT_ENABLED=y
CONFIG_BT_NIMBLE_ENABLED=y
CONFIG_BT_NIMBLE_HOST_ENABLED=y
CONFIG_BT_NIMBLE_ROLE_CENTRAL=y
CONFIG_BT_NIMBLE_ROLE_OBSERVER=y

# No runtime USB serial console in the HID-only build.
CONFIG_ESP_CONSOLE_NONE=y
```
